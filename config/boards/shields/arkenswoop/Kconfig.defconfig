## config/boards/shields/arkenswoop/Kconfig.defconfig
```kconfig
# Copyright (c) 2022 Duccio Breschi
# SPDX-License-Identifier: MIT

if SHIELD_ARKENSWOOP_LEFT

config ZMK_KEYBOARD_NAME
    default "arkenswoop"

config ZMK_SPLIT_ROLE_CENTRAL
    default y

endif # LEFT

if SHIELD_ARKENSWOOP_LEFT || SHIELD_ARKENSWOOP_RIGHT

config ZMK_SPLIT
    default y
    
endif # LEFT RIGHT
```
